## conf/bblayers.conf.sample
```bitbake
# POKY_BBLAYERS_CONF_VERSION is increased each time build/conf/bblayers.conf
# changes incompatibly
POKY_BBLAYERS_CONF_VERSION = "2"

BBPATH = "${TOPDIR}"
BBFILES ?= ""

BSPDIR := "${@os.path.abspath(os.path.dirname(d.getVar('FILE', True)) + '/../..')}"

BBLAYERS ?= " \
  ${BSPDIR}/sources/poky/meta \
  ${BSPDIR}/sources/poky/meta-poky \
  ${BSPDIR}/sources/poky/meta-yocto-bsp \
  ${BSPDIR}/sources/meta-xilinx \
  ${BSPDIR}/sources/meta-estei \
  ${BSPDIR}/sources/meta-qt5 \
  ${BSPDIR}/sources/meta-openembedded/meta-oe \
  "
```

## conf/distro/estei.conf
```bitbake
require conf/distro/poky.conf

DISTRO = "estei"
DISTRO_NAME = "Estei powered by Yocto/OE (Welcome to Bordeaux)"
DISTROOVERRIDES = "poky:estei"
SDK_VENDOR = "-esteisdk"
SDK_VERSION := "${@'${DISTRO_VERSION}'.replace('snapshot-${DATE}','snapshot')}"

DISTRO_FEATURES_remove ?= "opengl wayland x11 3g nfc pulseaudio zeroconf"

# Use systemd as init manager
#DISTRO_FEATURES_append = " systemd"
#VIRTUAL-RUNTIME_init_manager = "systemd"
#DISTRO_FEATURES_BACKFILL_CONSIDERED = "sysvinit"

MAINTAINER = "Pierre-Jean TEXIER <pjtexier@amplitude-systemes.com>"
```

## conf/layer.conf
```bitbake
# We have a conf and classes directory, add to BBPATH
BBPATH .= ":${LAYERDIR}"

# We have recipes-* directories, add to BBFILES
BBFILES += "${LAYERDIR}/recipes-*/*/*.bb \
	${LAYERDIR}/recipes-*/*/*.bbappend"

BBFILE_COLLECTIONS += "estei"
BBFILE_PATTERN_estei = "^${LAYERDIR}/"
BBFILE_PRIORITY_estei = "9"

# List of estei base distribution's dependencies
LAYERDEPENDS_estei = "core \
                      yocto \
                      yoctobsp \
                      openembedded-layer \
                      qt5-layer \
                      "
```

## conf/local.conf.sample
```bitbake
MACHINE ??= "zedboard-zynq7"

# Where to place downloads
#
#
# The default is a downloads directory under TOPDIR which is the build directory.
#
DL_DIR ?= "${TOPDIR}/downloads"

#INHERIT += "own-mirrors"
#SOURCE_MIRROR_URL = "http://example.com/my-source-mirror"
#
# Where to place shared-state files
#
# BitBake has the capability to accelerate builds based on previously built output.
# This is done using "shared state" files which can be thought of as cache objects
# and this option determines where those files are placed.
#
# You can wipe out TMPDIR leaving this directory intact and the build would regenerate
# from these files if no changes were made to the configuration. If changes were made
# to the configuration, only shared state files where the state was still valid would
# be used (done using checksums).
#
# The default is a sstate-cache directory under TOPDIR.
#
#SSTATE_DIR ?= "${TOPDIR}/sstate-cache"

#
# Where to place the build output
#
# This option specifies where the bulk of the building work should be done and
# where BitBake should place its temporary files and output. Keep in mind that
# this includes the extraction and compilation of many applications and the toolchain
# which can use Gigabytes of hard disk space.
#
# The default is a tmp directory under TOPDIR.
#
#TMPDIR = "${TOPDIR}/tmp"

DISTRO ?= "poky"
PACKAGE_CLASSES ?= "package_rpm"

BB_NUMBER_THREADS = '8'
PARALLEL_MAKE = '-j 8'

DISTRO_FEATURES_remove = "x11 wayland"

#
# SDK target architecture
#SDKMACHINE ?= "x86_64"

EXTRA_IMAGE_FEATURES ?= "debug-tweaks"

PATCHRESOLVE = "noop"

BB_DISKMON_DIRS = "\
    STOPTASKS,${TMPDIR},1G,100K \
    STOPTASKS,${DL_DIR},1G,100K \
    STOPTASKS,${SSTATE_DIR},1G,100K \
    STOPTASKS,/tmp,100M,100K \
    ABORT,${TMPDIR},100M,1K \
    ABORT,${DL_DIR},100M,1K \
    ABORT,${SSTATE_DIR},100M,1K \
    ABORT,/tmp,10M,1K"

PACKAGECONFIG_append_pn-qemu-native = " sdl"
PACKAGECONFIG_append_pn-nativesdk-qemu = " sdl"

# CONF_VERSION is increased each time build/conf/ changes incompatibly and is used to
# track the version of this file when it was generated. This can safely be ignored if
# this doesn't mean anything to you.
CONF_VERSION = "1"
```

## conf/machine/qemu-estei.conf
```bitbake
#@TYPE: Machine
#@NAME: A custom Qemux86-64 to check Estei distribution

PREFERRED_PROVIDER_virtual/xserver ?= "xserver-xorg"
PREFERRED_PROVIDER_virtual/libgl ?= "mesa"
PREFERRED_PROVIDER_virtual/libgles1 ?= "mesa"
PREFERRED_PROVIDER_virtual/libgles2 ?= "mesa"

require conf/machine/include/qemu.inc

MACHINEOVERRIDES = "qemux86-64:qemu-estei"

DEFAULTTUNE = "corei7-64"

require conf/machine/include/tune-corei7.inc

KERNEL_IMAGETYPE = "bzImage"

SERIAL_CONSOLES = "115200;ttyS0 115200;ttyS1"
INITRAMFS_FSTYPES = "cpio"
XSERVER = "xserver-xorg \
           ${@bb.utils.contains('DISTRO_FEATURES', 'opengl', 'mesa-driver-swrast xserver-xorg-extension-glx', '', d)} \
           xf86-input-vmmouse \
           xf86-input-keyboard \
           xf86-input-evdev \
           xf86-video-cirrus \
           xf86-video-fbdev \
           xf86-video-vmware"

MACHINE_FEATURES += "x86"

MACHINE_ESSENTIAL_EXTRA_RDEPENDS += "v86d"
```
